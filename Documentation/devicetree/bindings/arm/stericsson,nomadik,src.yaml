## Documentation/devicetree/bindings/sound/cirrus,cs35l32.yaml
```yaml
# SPDX-License-Identifier: (GPL-2.0-only OR BSD-2-Clause)
%YAML 1.2
---
$id: http://devicetree.org/schemas/sound/cirrus,cs35l32.yaml#
$schema: http://devicetree.org/meta-schemas/core.yaml#

title: Cirrus CS35L32 audio CODEC

maintainers:
  - Brian Austin <brian.austin@cirrus.com>

description: |
  CS35L32 audio CODEC

properties:
  compatible:
    const: cirrus,cs35l32

  reg:
    items:
      - description: |
          the I2C address of the device as determined by the level of the AD0 pin.
          Level 0 is 0x40 while Level 1 is 0x41.
  reset-gpios:
    maxItems: 1

  VA-supply:
    description: Power supply for VA

  VP-supply:
    description: Power supply for VP

  cirrus,battery-recovery:
    description: Low battery nominal recovery threshold, rising VP.
    $ref: /schemas/types.yaml#/definitions/uint32
    enum: [0, 1, 2, 3]

  cirrus,battery-threshold:
    description: Low battery nominal threshold, falling VP.
    $ref: /schemas/types.yaml#/definitions/uint32
    enum: [0, 1, 2, 3, 4, 5]

  cirrus,boost-manager:
    description: Boost voltage control.
    $ref: /schemas/types.yaml#/definitions/uint32
    enum: [0, 1, 2, 3]

  cirrus,sdout-datacfg:
    description: Data configuration for dual CS35L32 applications only.
    $ref: /schemas/types.yaml#/definitions/uint32
    enum: [0, 1, 2, 3]

  cirrus,sdout-share:
    description: SDOUT sharing. Determines whether one or two CS35L32 devices are on board sharing SDOUT.
    $ref: /schemas/types.yaml#/definitions/uint32
    enum: [0, 1]

required:
  - compatible
  - reg
  - VA-supply
  - VP-supply

additionalProperties: false

examples:
  - |
    i2c {
        #address-cells = <1>;
        #size-cells = <0>;
        codec@40 {
            compatible = "cirrus,cs35l32";
            reg = <0x40>;
            reset-gpios = <&gpio 10 0>;
            cirrus,boost-manager = <0x03>;
            cirrus,sdout-datacfg = <0x02>;
            VA-supply = <&reg_audio>;
        };
    };
```

## Documentation/devicetree/bindings/sound/realtek,rt5663.yaml
```yaml
# SPDX-License-Identifier: (GPL-2.0-only OR BSD-2-Clause)
%YAML 1.2
---
$id: http://devicetree.org/schemas/sound/realtek,rt5663.yaml#
$schema: http://devicetree.org/meta-schemas/core.yaml#

title: Realtek RT5663 audio CODEC

maintainers:
  - Bard Liao <bardliao@realtek.com>
  - Cheng-Yi Chiang <cychiang@chromium.org>
  - Fabio Estevam <fabio.estevam@nxp.com>
  - Oder Chiou <oder_chiou@realtek.com>

properties:
  compatible:
    const: realtek,rt5663

  reg:
    maxItems: 1

  interrupts:
    maxItems: 1

  avdd-supply:
    description: Power supply for AVDD, providing 1.8V.

  cpvdd-supply:
    description: Power supply for CPVDD, providing 3.5V.

  realtek,dc_offset_l_manual:
    description: Manual DC offset for left headphone channel.
    $ref: /schemas/types.yaml#/definitions/uint32

  realtek,dc_offset_r_manual:
    description: Manual DC offset for right headphone channel.
    $ref: /schemas/types.yaml#/definitions/uint32

  realtek,dc_offset_l_manual_mic:
    description: Manual DC offset for left microphone channel.
    $ref: /schemas/types.yaml#/definitions/uint32

  realtek,dc_offset_r_manual_mic:
    description: Manual DC offset for right microphone channel.
    $ref: /schemas/types.yaml#/definitions/uint32

  realtek,impedance_sensing_num:
    description: Number of impedance sensing table rows; 0 indicates unsupported.
    $ref: /schemas/types.yaml#/definitions/uint32

  realtek,impedance_sensing_table:
    description: Matrix rows of the impedance sensing table.
    $ref: /schemas/types.yaml#/definitions/uint32-matrix
    items:
      items:
        - description: Minimum impedance.
        - description: Maximum impedance.
        - description: Volume.
        - description: DC offset without microphone for left channel.
        - description: DC offset without microphone for right channel.
        - description: DC offset with microphone for left channel.
        - description: DC offset with microphone for right channel.

required:
  - compatible
  - reg
  - interrupts

additionalProperties: false

examples:
  - |
    codec@12 {
        compatible = "realtek,rt5663";
        reg = <0x12>;
        interrupts = <7 IRQ_TYPE_EDGE_FALLING>;
        avdd-supply = <&pp1800_a_alc5662>;
        cpvdd-supply = <&pp3500_a_alc5662>;
    };
```

## Documentation/devicetree/bindings/sound/ti,omap4-dmic.yaml
```yaml
# SPDX-License-Identifier: (GPL-2.0-only OR BSD-2-Clause)
%YAML 1.2
---
$id: http://devicetree.org/schemas/sound/ti,omap4-dmic.yaml#
$schema: http://devicetree.org/meta-schemas/core.yaml#

title: Texas Instruments OMAP4+ Digital Microphone Module

maintainers:
  - Peter Ujfalusi <peter.ujfalusi@ti.com>

properties:
  compatible:
    const: ti,omap4-dmic

  reg:
    items:
      - description: MPU private access registers.
      - description: L3 interconnect registers.
    description: Register location and size as an array.

  interrupts:
    maxItems: 1

required:
  - compatible
  - reg
  - interrupts

additionalProperties: false

examples:
  - |
    dmic@4012e000 {
        compatible = "ti,omap4-dmic";
        reg = <0x4012e000 0x7f>,
              <0x4902e000 0x7f>;
        interrupts = <0 114 0x4>;
    };
```

## Documentation/devicetree/bindings/spi/cirrus,ep7209-spi.yaml
```yaml
# SPDX-License-Identifier: (GPL-2.0-only OR BSD-2-Clause)
%YAML 1.2
---
$id: http://devicetree.org/schemas/spi/cirrus,ep7209-spi.yaml#
$schema: http://devicetree.org/meta-schemas/core.yaml#

title: Cirrus Logic CL-PS71xx SPI Controller

maintainers:
  - Arnd Bergmann <arnd@arndb.de>

description: |
  Serial Peripheral Interface on Cirrus Logic CL-PS71xx, EP72xx, EP73xx

  An additional register is present in the system controller,
  which is assumed to be in the same device tree and marked
  as compatible with "cirrus,ep7209-syscon3".

allOf:
  - $ref: /schemas/spi/spi-controller.yaml#

properties:
  compatible:
    const: cirrus,ep7209-spi

  reg:
    maxItems: 1

  interrupts:
    maxItems: 1

  clocks:
    maxItems: 1

required:
  - compatible
  - reg
  - interrupts
  - clocks
  - cs-gpios

unevaluatedProperties: false

examples:
  - |
    spi@80000500 {
      #address-cells = <1>;
      #size-cells = <0>;
      compatible = "cirrus,ep7209-spi";
      reg = <0x80000500 0x4>;
      interrupts = <15>;
      clocks = <&clks CLPS711X_CLK_SPI>;
      cs-gpios = <&gpio0 3>;
    };
```

## Documentation/devicetree/bindings/thermal/marvell,dove-thermal.yaml
```yaml
# SPDX-License-Identifier: (GPL-2.0-only OR BSD-2-Clause)
%YAML 1.2
---
$id: http://devicetree.org/schemas/thermal/marvell,dove-thermal.yaml#
$schema: http://devicetree.org/meta-schemas/core.yaml#

title: Marvell Dove Thermal Sensor

maintainers:
  - Andrew Lunn <andrew@lunn.ch>

properties:
  compatible:
    const: marvell,dove-thermal

  reg:
    items:
      - description: Thermal Manager registers
      - description: Thermal Diode Control Registers

required:
  - compatible
  - reg

additionalProperties: false

examples:
  - |
    thermal@10078 {
        compatible = "marvell,dove-thermal";
        reg = <0xd001c 0x0c>, <0xd005c 0x08>;
    };
```

## Documentation/devicetree/bindings/thermal/marvell,kirkwood-thermal.yaml
```yaml
# SPDX-License-Identifier: (GPL-2.0-only OR BSD-2-Clause)
%YAML 1.2
---
$id: http://devicetree.org/schemas/thermal/marvell,kirkwood-thermal.yaml#
$schema: http://devicetree.org/meta-schemas/core.yaml#

title: marvell,kirkwood-thermal

maintainers:
  - Nobuhiro Iwamatsu <iwamatsu@nigauri.org>

description:
  This version is for Kirkwood 88F8262 & 88F6283 SoCs. Other kirkwoods don't
  contain a thermal sensor.

properties:
  compatible:
    const: marvell,kirkwood-thermal

  reg:
    maxItems: 1

required:
  - compatible
  - reg

additionalProperties: false

examples:
  - |
    thermal@10078 {
        compatible = "marvell,kirkwood-thermal";
        reg = <0x10078 0x4>;
    };
```

## Documentation/devicetree/bindings/thermal/ti,omap34xx-bandgap.yaml
```yaml
# SPDX-License-Identifier: (GPL-2.0-only OR BSD-2-Clause)
%YAML 1.2
---
$id: http://devicetree.org/schemas/thermal/ti,omap34xx-bandgap.yaml#
$schema: http://devicetree.org/meta-schemas/core.yaml#

title: TI OMAP SCM Bandgap

maintainers:
  - Eduardo Valentin <eduardo.valentin@ti.com>
  - Eduardo Valentin <edubezval@gmail.com>
  - Pavel Machek <pavel@ucw.cz>

description:
  In the System Control Module, OMAP supplies a voltage reference and a
  temperature sensor feature that are gathered in the band gap voltage and
  temperature sensor (VBGAPTS) module. The band gap provides current and voltage
  reference for its internal circuits and other analog IP blocks. The
  analog-to-digital converter (ADC) produces an output value that is
  proportional to the silicon temperature.

allOf:
  - $ref: thermal-sensor.yaml#

properties:
  compatible:
    items:
      - enum:
          - ti,omap34xx-bandgap
          - ti,omap36xx-bandgap
          - ti,omap4430-bandgap
          - ti,omap4460-bandgap
          - ti,omap4470-bandgap
          - ti,omap5430-bandgap
          - ti,dra752-bandgap

  reg:
    minItems: 1
    maxItems: 6

  interrupts:
    maxItems: 1
    description: Interrupt specifier for the talert signal.

  gpios:
    description: GPIO specifier for the tshut signal, treated as an IRQ.
    maxItems: 1

required:
  - compatible
  - reg
  - interrupts

unevaluatedProperties: false

examples:
  - |
    bandgap {
        compatible = "ti,omap4460-bandgap";
        reg = <0x4a002260 0x4>,
              <0x4a00232C 0x4>,
              <0x4a002378 0x18>;
        interrupts = <0 126 4>;
        gpios = <&gpio3 22 0>;
        #thermal-sensor-cells = <1>;
    };
```

## drivers/accel/ethos/Kconfig
```kconfig
# SPDX-License-Identifier: GPL-2.0-only

config DRM_ACCEL_ARM_ETHOS
	tristate "Arm Ethos-U NPU"
	depends on DRM_ACCEL
	depends on HAS_IOMEM
	help
	  Enables driver for Arm Ethos-U65/U85 NPUs
```

## drivers/gpu/drm/nova/Kconfig
```kconfig
config DRM_NOVA_STUB
	tristate "Nova GPU driver stub"
	depends on DRM
	depends on PCI
	depends on RUST
```
