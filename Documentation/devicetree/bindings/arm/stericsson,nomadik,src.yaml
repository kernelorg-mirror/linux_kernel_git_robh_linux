## Documentation/devicetree/bindings/mfd/ams,as3722.yaml
```yaml
# SPDX-License-Identifier: (GPL-2.0-only OR BSD-2-Clause)
%YAML 1.2
---
$id: http://devicetree.org/schemas/mfd/ams,as3722.yaml#
$schema: http://devicetree.org/meta-schemas/core.yaml#

title: ams,as3722 Power management IC.

maintainers:
  - Guenter Roeck <linux@roeck-us.net>
  - Laxman Dewangan <ldewangan@nvidia.com>
  - Marcel Ziswiler <marcel.ziswiler@toradex.com>

properties:
  compatible:
    const: ams,as3722

  reg:
    maxItems: 1

  interrupts:
    maxItems: 1

  '#gpio-cells':
    const: 2

  gpio-controller: true

  '#interrupt-cells':
    const: 2

  interrupt-controller: true

  ams,system-power-controller:
    type: boolean

  pinmux:
    type: object
    additionalProperties: false

    patternProperties:
      '^gpio':
        type: object
        $ref: /schemas/pinctrl/pincfg-node.yaml

        properties:
          pins:
            items:
              pattern: '^gpio[0-7]$'

          function:
            enum: [ gpio, interrupt-out, gpio-in-interrupt,
                    vsup-vbat-low-undebounce-out, vsup-vbat-low-debounce-out,
                    voltage-in-standby, oc-pg-sd0, oc-pg-sd6, powergood-out,
                    pwm-in, pwm-out, clk32k-out, watchdog-in, soft-reset-in
            ]

  regulators:
    description: Container node for regulator supplies and subnodes
    type: object
    additionalProperties: false

    properties:
      vsup-sd2-supply:
        description: Input supply for SD2

      vsup-sd3-supply:
        description: Input supply for SD3

      vsup-sd4-supply:
        description: Input supply for SD4

      vsup-sd5-supply:
        description: Input supply for SD5

      vin-ldo0-supply:
        description: Input supply for LDO0

      vin-ldo1-6-supply:
        description: Input supply for LDO1 and LDO6

      vin-ldo2-5-7-supply:
        description: Input supply for LDO2, LDO5 and LDO7

      vin-ldo3-4-supply:
        description: Input supply for LDO3 and LDO4

      vin-ldo9-10-supply:
        description: Input supply for LDO9 and LDO10

      vin-ldo11-supply:
        description: Input supply for LDO11

    patternProperties:
      '^(sd[0-6]|ldo([0-7]|9|10|11))$':
        description: Configuration for each regulator sub-node
        type: object
        $ref: /schemas/regulator/regulator.yaml#
        unevaluatedProperties: false

        properties:
          ams,ext-control:
            description: >
              External control of the rail. Valid values:

                0 = no external control
                1 = ENABLE1
                2 = ENABLE2
                3 = ENABLE3

              Missing this property on DT will be assumed as no external control.
              The external control pin macros are defined in dt-bindings/mfd/as3722.h
            $ref: /schemas/types.yaml#/definitions/uint32
            enum: [0, 1, 2, 3]

          ams,enable-tracking:
            description: Enable tracking with SD1, only supported by LDO3
            type: boolean

        required:
          - regulator-name
          - regulator-min-microvolt
          - regulator-max-microvolt

required:
  - compatible
  - reg

additionalProperties: false

examples:
  - |
    i2c {
        #address-cells = <1>;
        #size-cells = <0>;

        pmic@40 {
            compatible = "ams,as3722";
            reg = <0x40>;

            regulators {
                vsup-sd2-supply = <&vdd_ddr>;
                vin-ldo3-4-supply = <&vdd_sys>;

                sd0 {
                    regulator-name = "vdd_cpu";
                    regulator-min-microvolt = <700000>;
                    regulator-max-microvolt = <1400000>;
                    regulator-always-on;
                    ams,ext-control = <2>;
                };

                sd1 {
                    regulator-name = "vdd_core";
                    regulator-min-microvolt = <700000>;
                    regulator-max-microvolt = <1400000>;
                    regulator-always-on;
                    ams,ext-control = <1>;
                };

                sd2 {
                    regulator-name = "vddio_ddr";
                    regulator-min-microvolt = <1350000>;
                    regulator-max-microvolt = <1350000>;
                    regulator-always-on;
                };

                ldo3 {
                    regulator-name = "avdd-hdmi-pex";
                    regulator-min-microvolt = <1050000>;
                    regulator-max-microvolt = <1050000>;
                    regulator-always-on;
                    ams,enable-tracking;
                };
            };
        };
    };
```

## Documentation/devicetree/bindings/mips/cavium/cavium,octeon-6335-uctl.yaml
```yaml
%YAML 1.2
---
$id: http://devicetree.org/schemas/cavium,octeon-6335-uctl.yaml#
$schema: http://devicetree.org/meta-schemas/core.yaml#

title: UCTL USB controller glue

maintainers:
  - David Daney <david.daney@cavium.com>

properties:
  compatible:
    const: cavium,octeon-6335-uctl

  reg:
    maxItems: 1

  '#address-cells':
    const: 2

  '#size-cells':
    const: 2

  ranges: true

  refclk-frequency:
    description: Reference clock frequency in Hz
    $ref: /schemas/types.yaml#/definitions/uint32

  refclk-type:
    enum:
      - crystal
      - external
    description: Reference clock connection type

required:
  - compatible
  - reg
  - '#address-cells'
  - '#size-cells'
  - ranges
  - refclk-frequency
  - refclk-type

additionalProperties: false

examples:
  - |
    uctl@118006f000000 {
        compatible = "cavium,octeon-6335-uctl";
        reg = <0x11800 0x6f000000 0x0 0x100>;
        ranges; /* Direct mapping */
        #address-cells = <2>;
        #size-cells = <2>;
        /* 12MHz, 24MHz and 48MHz allowed */
        refclk-frequency = <24000000>;
        /* Either "crystal" or "external" */
        refclk-type = "crystal";

        ehci@16f0000000000 {
            compatible = "cavium,octeon-6335-ehci", "usb-ehci";
            reg = <0x16f00 0x00000000 0x0 0x100>;
            interrupts = <0 56>;
            big-endian-regs;
        };
        ohci@16f0000000400 {
            compatible = "cavium,octeon-6335-ohci", "usb-ohci";
            reg = <0x16f00 0x00000400 0x0 0x100>;
            interrupts = <0 56>;
            big-endian-regs;
        };
    };
```

## Documentation/devicetree/bindings/mmc/st,sdhci.yaml
```yaml
---
$id: http://devicetree.org/schemas/mmc/st,sdhci.yaml#
$schema: http://devicetree.org/meta-schemas/core.yaml#

title: STMicroelectronics sdhci-st MMC/SD controller

maintainers:
  - Lee Jones <lee@kernel.org>
  - Marco Franchi <marco.franchi@nxp.com>
  - Masanari Iida <standby24x7@gmail.com>
  - Mauro Carvalho Chehab <mchehab+samsung@kernel.org>
  - Peter Griffin <peter.griffin@linaro.org>
  - Simon Horman <horms+renesas@verge.net.au>

allOf:
  - $ref: sdhci-common.yaml#

properties:
  compatible:
    items:
      - const: st,sdhci-stih407
      - const: st,sdhci

  reg:
    items:
      - description: host controller base address
      - description: FlashSS Top register for TX/RX delay used by the driver to configure DLL inside FlashSS

  reg-names:
    items:
      - const: mmc
      - const: top-mmc-delay

  interrupts:
    maxItems: 1

  interrupt-names:
    items:
      - const: mmcirq

  clocks:
    items:
      - description: MMC bus clock
      - description: internal clock (icn)

  clock-names:
    items:
      - const: mmc
      - const: icn

  resets:
    maxItems: 1

  max-frequency:
    allOf:
      - $ref: /schemas/types.yaml#/definitions/uint32
    description: maximum bus frequency
    enum: [200000000, 100000000, 50000000]

required:
  - compatible
  - reg
  - interrupts
  - interrupt-names
  - clocks
  - clock-names

unevaluatedProperties: false

examples:
  - |
    mmc@9060000 {
        compatible = "st,sdhci-stih407", "st,sdhci";
        reg = <0x09060000 0x7ff>, <0x9061008 0x20>;
        reg-names = "mmc", "top-mmc-delay";
        interrupts = <GIC_SPI 92 IRQ_TYPE_NONE>;
        interrupt-names = "mmcirq";
        clock-names = "mmc";
        clocks = <&clk_s_c0_flexgen CLK_MMC_0>;
        vqmmc-supply = <&vmmc_reg>;
        max-frequency = <200000000>;
        bus-width = <8>;
        non-removable;
        sd-uhs-sdr50;
        sd-uhs-sdr104;
        sd-uhs-ddr50;
    };
```

## Documentation/devicetree/bindings/net/st,stih407-dwmac.yaml
```yaml
# SPDX-License-Identifier: (GPL-2.0-only OR BSD-2-Clause)
%YAML 1.2
---
$id: http://devicetree.org/schemas/net/st,stih407-dwmac.yaml#
$schema: http://devicetree.org/meta-schemas/core.yaml#

title: STMicroelectronics SoC DWMAC glue layer controller

maintainers:
  - Alain Volmat <avolmat@me.com>
  - Giuseppe CAVALLARO <peppe.cavallaro@st.com>
  - Peter Griffin <peter.griffin@linaro.org>
  - Srinivas Kandagatla <srinivas.kandagatla@st.com>

description: |
  STMicroelectronics SoC DWMAC glue layer controller

  This file documents differences between the core properties in
  Documentation/devicetree/bindings/net/stmmac.txt
  and what is needed on STi platforms to program the stmmac glue logic.

select:
  properties:
    compatible:
      contains:
        const: st,stih407-dwmac

  required:
    - compatible

allOf:
  - $ref: /schemas/net/snps,dwmac.yaml#

properties:
  compatible:
    items:
      - const: st,stih407-dwmac
      - const: snps,dwmac
      - const: snps,dwmac-3.710

  reg:
    maxItems: 1

  reg-names:
    items:
      - const: stmmaceth

  clocks:
    description: Clocks controlling MAC and PHY interfaces
    items:
      - description: stmmac interface clock
      - description: PHY interface clock

  clock-names:
    items:
      - const: stmmaceth
      - const: sti-ethclk

  interrupts:
    items:
      - description: MAC interrupt
      - description: Ethernet wake interrupt
      - description: Ethernet low power idle interrupt

  interrupt-names:
    items:
      - const: macirq
      - const: eth_wake_irq
      - const: eth_lpi

  st,syscon:
    description: syscon for MAC glue logic control registers
    $ref: /schemas/types.yaml#/definitions/phandle-array
    items:
      - items:
          - description: phandle to syscon register bank
          - description: offset of the control register

  st,gmac_en:
    description: Enable GMAC via dedicated sysctl control register
    type: boolean

  resets:
    maxItems: 1

  reset-names:
    items:
      - const: stmmaceth

  st,ext-phyclk:
    description: External PHY clock phandle for RMII mode
    $ref: /schemas/types.yaml#/definitions/phandle

  st,tx-retime-src:
    description: TX retiming source for MAC TX lines
    enum:
      - txclk
      - clk_125
      - clkgen

  sti-ethclk:
    description: PHY clock phandle
    $ref: /schemas/types.yaml#/definitions/phandle

  sti-clkconf:
    description: Extra sysconfig register for clock retiming
    $ref: /schemas/types.yaml#/definitions/phandle-array
    items:
      - items:
          - description: phandle to sysconfig register bank
          - description: offset of clock retiming register

  snps,pbl:
    description: Programmable burst length
    $ref: /schemas/types.yaml#/definitions/uint32

  snps,mixed-burst:
    description: Enable mixed burst transfers
    type: boolean

additionalProperties: false

required:
  - compatible
  - st,syscon
  - st,gmac_en
  - pinctrl-0

examples:
  - |
    ethernet@9630000 {
        device_type = "network";
        compatible = "st,stih407-dwmac", "snps,dwmac", "snps,dwmac-3.710";
        reg = <0x9630000 0x8000>;
        reg-names = "stmmaceth";
        st,syscon = <&syscfg_sbc_reg 0x80>;
        st,gmac_en;
        resets = <&softreset STIH407_ETH1_SOFTRESET>;
        reset-names = "stmmaceth";
        interrupts = <GIC_SPI 98 IRQ_TYPE_NONE>,
                     <GIC_SPI 99 IRQ_TYPE_NONE>,
                     <GIC_SPI 100 IRQ_TYPE_NONE>;
        interrupt-names = "macirq", "eth_wake_irq", "eth_lpi";
        snps,pbl = <32>;
        snps,mixed-burst;
        pinctrl-names = "default";
        pinctrl-0 = <&pinctrl_rgmii1>;
        clock-names = "stmmaceth", "sti-ethclk";
        clocks = <&CLK_S_C0_FLEXGEN CLK_EXT2F_A9>,
                 <&CLK_S_C0_FLEXGEN CLK_ETH_PHY>;
    };
```

## Documentation/devicetree/bindings/npu/arm,ethos.yaml
```yaml
# SPDX-License-Identifier: GPL-2.0-only OR BSD-2-Clause
%YAML 1.2
---
$id: http://devicetree.org/schemas/npu/arm,ethos.yaml#
$schema: http://devicetree.org/meta-schemas/core.yaml#

title: Arm Ethos U65/U85

maintainers:
  - Rob Herring <robh@kernel.org>

properties:
  compatible:
    oneOf:
      - items:
          - enum:
              - fsl,imx93-npu
          - const: arm,ethos-u65
      - items:
          - enum:
              - arm,corstone1000-npu
          - const: arm,ethos-u85

  reg:
    maxItems: 1

  interrupts:
    maxItems: 1

  clocks:
    maxItems: 2

  clock-names:
    items:
      - const: core
      - const: apb

  power-domains:
    maxItems: 1

  dma-coherent: true

  sram:
    maxItems: 1

required:
  - compatible
  - reg
  - interrupts
  - clocks

additionalProperties: false

examples:
  - |
    #include <dt-bindings/interrupt-controller/irq.h>
    #include <dt-bindings/interrupt-controller/arm-gic.h>

    npu@4a900000 {
        compatible = "fsl,imx93-npu", "arm,ethos-u65";
        reg = <0x4a900000 0x1000>;
        interrupts = <GIC_SPI 178 IRQ_TYPE_LEVEL_HIGH>;
        power-domains = <&mlmix>;
        clocks = <&clk IMX93_CLK_ML>, <&clk IMX93_CLK_ML_APB>;
        clock-names = "core", "apb";
        sram = <&sram>;
    };

...
```

## Documentation/devicetree/bindings/reset/ti,syscon-reset.yaml
```yaml
# SPDX-License-Identifier: (GPL-2.0-only OR BSD-2-Clause)
%YAML 1.2
---
$id: http://devicetree.org/schemas/reset/ti,syscon-reset.yaml#
$schema: http://devicetree.org/meta-schemas/core.yaml#

title: TI SysCon Reset Controller

maintainers:
  - Andrew F. Davis <afd@ti.com>
  - Marco Franchi <marco.franchi@nxp.com>
  - Suman Anna <s-anna@ti.com>

description: >
  Almost all SoCs have hardware modules that require reset control in addition
  to clock and power control for their functionality. The reset control is
  typically provided by means of memory-mapped I/O registers. These registers
  are sometimes a part of a larger register space region implementing various
  functionalities. This register range is best represented as a syscon node to
  allow multiple entities to access their relevant registers in the common
  register space.

  A SysCon Reset Controller node defines a device that uses a syscon node and
  provides reset management functionality for various hardware modules present
  on the SoC.

properties:
  compatible:
    items:
      - enum:
          - ti,k2e-pscrst
          - ti,k2l-pscrst
          - ti,k2hk-pscrst
      - const: ti,syscon-reset

  '#reset-cells':
    const: 1

  ti,reset-bits:
    description: >
      Contains the reset control register information.
    $ref: /schemas/types.yaml#/definitions/uint32-matrix
    items:
      items:
        - description: offset of the reset assert control register
        - description: bit position in the reset assert control register
        - description: offset of the reset deassert control register
        - description: bit position in the reset deassert control register
        - description: offset of the reset status register
        - description: bit position in the reset status register
        - description: flags controlling reset behavior

required:
  - compatible
  - '#reset-cells'
  - ti,reset-bits

additionalProperties: false

examples:
  - |
    #include <dt-bindings/reset/ti-syscon.h>

    reset-controller {
        compatible = "ti,k2e-pscrst", "ti,syscon-reset";
        #reset-cells = <1>;
        ti,reset-bits = <
            0xa3c 8 0xa3c 8 0x83c 8 (ASSERT_CLEAR | DEASSERT_SET | STATUS_CLEAR)
            0xa40 5 0xa44 3 0     0 (ASSERT_SET   | DEASSERT_CLEAR | STATUS_NONE)
        >;
    };
```
