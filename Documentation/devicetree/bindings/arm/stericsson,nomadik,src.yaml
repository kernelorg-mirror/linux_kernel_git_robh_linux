## Documentation/devicetree/bindings/arm/stericsson,nomadik,src.yaml
```yaml
%YAML 1.2
---
$id: http://devicetree.org/schemas/stericsson,nomadik,src.yaml#
$schema: http://devicetree.org/meta-schemas/core.yaml#

title: ST-Ericsson Nomadik System and Reset Controller

maintainers:
  - Linus Walleij <linus.walleij@linaro.org>

properties:
  $nodename:
    const: '/'
    
  compatible:
    description: Identify the SoC or board variant
    enum:
      - st,nomadik-nhk-15
      - calaosystems,usb-s8815

  usb-s8815:
    description: USB-S8815 child node on Calao MiniKit
    type: object
    additionalProperties: false
    properties:
      ethernet-gpio-node:
        description: Ethernet GPIO child node
        type: object
        additionalProperties: false
        properties:
          gpios:
            description: GPIO specifier for ethernet
            maxItems: 1
          interrupts:
            description: Interrupt specifier for ethernet
            maxItems: 1
        required:
          - gpios
          - interrupts
      mmcsd-gpio-node:
        description: MMC/SD GPIO child node
        type: object
        additionalProperties: false
        properties:
          gpios:
            description: GPIO specifier for MMC/SD
            maxItems: 1
        required:
          - gpios

required:
  - compatible

allOf:
  - if:
      properties:
        compatible:
          contains:
            const: calao­systems,usb-s8815
    then:
      required:
        - usb-s8815
    else:
      properties:
        usb-s8815: false

additionalProperties: true
```

## Documentation/devicetree/bindings/display/ti/ti,omap5-dss.yaml
```yaml
# SPDX-License-Identifier: (GPL-2.0-only OR BSD-2-Clause)
%YAML 1.2
---
$id: http://devicetree.org/schemas/display/ti/ti,omap5-dss.yaml#
$schema: http://devicetree.org/meta-schemas/core.yaml#

title: Texas Instruments OMAP5 Display Subsystem

maintainers:
  - Peter Ujfalusi <peter.ujfalusi@ti.com>

description: |
  Texas Instruments OMAP5 Display Subsystem

  See Documentation/devicetree/bindings/display/ti/ti,omap-dss.txt for generic
  description about OMAP Display Subsystem bindings.

properties:
  compatible:
    const: ti,omap5-dss

  reg:
    maxItems: 1

  clocks:
    maxItems: 1

  clock-names:
    items:
      - const: fck

  DISPC:
    description: Display controller
    type: object
    additionalProperties: false

    properties:
      compatible:
        const: ti,omap5-dispc

      reg:
        maxItems: 1

      interrupts:
        maxItems: 1

      clocks:
        maxItems: 1

      clock-names:
        items:
          - const: fck

      max-memory-bandwidth:
        description: Input memory (from main memory to DISPC) bandwidth limit in bytes per second
        $ref: /schemas/types.yaml#/definitions/uint32

    required:
      - compatible
      - reg
      - interrupts
      - clocks
      - clock-names

  RFBI:
    description: Raster frame buffer interface
    type: object

    properties:
      compatible:
        items:
          - const: ti,omap5-rfbi

      reg:
        description: Base address and length of the RFBI register space
        items:
          - description: RFBI registers

      clocks:
        description: Clocks used by RFBI

      clock-names:
        items:
          - const: fck
          - const: ick

    required:
      - compatible
      - reg
      - clocks
      - clock-names

    additionalProperties: false

  DSI:
    description: Display Serial Interface controller
    type: object

    properties:
      compatible:
        items:
          - const: ti,omap5-dsi

      reg:
        items:
          - description: proto registers
          - description: phy registers
          - description: pll registers

      reg-names:
        items:
          - const: proto
          - const: phy
          - const: pll

      vdd-supply: true

      clocks:
        maxItems: 2

      clock-names:
        items:
          - const: fck
          - const: sys_clk

    required:
      - compatible
      - reg
      - reg-names
      - ti,hwmods
      - vdd-supply
      - clocks
      - clock-names

    additionalProperties: false

  HDMI:
    description: HDMI transmitter
    type: object

    properties:
      compatible:
        items:
          - const: ti,omap5-hdmi

      reg:
        items:
          - description: wp registers
          - description: pll registers
          - description: phy registers
          - description: core registers

      reg-names:
        items:
          - const: wp
          - const: pll
          - const: phy
          - const: core

      interrupts:
        maxItems: 1

      vdda-supply: true

      clocks:
        maxItems: 1

      clock-names:
        items:
          - const: fck
          - const: sys_clk

    required:
      - compatible
      - reg
      - reg-names
      - interrupts
      - vdda-supply
      - clocks
      - clock-names

    additionalProperties: false

required:
  - compatible
  - reg
  - ti,hwmods
  - clocks
  - clock-names
  - DISPC

additionalProperties: false

examples:
  - |
    dss: display-subsystem@4a000000 {
      compatible = "ti,omap5-dss";
      reg = <0x4a000000 0x1000>;
      ti,hwmods = "dss_core";
      clocks = <&fclk>;
      clock-names = "fck";
      DISPC: dispc@4a002000 {
        compatible = "ti,omap5-dispc";
        reg = <0x4a002000 0x1000>;
        ti,hwmods = "dss_dispc";
        interrupts = <72>;
        clocks = <&fclk>;
        clock-names = "fck";
      };
    };
```

## Documentation/devicetree/bindings/dma/ti,edma3-tpcc.yaml
```yaml
# SPDX-License-Identifier: (GPL-2.0-only OR BSD-2-Clause)
%YAML 1.2
---
$id: http://devicetree.org/schemas/dma/ti,edma3-tpcc.yaml#
$schema: http://devicetree.org/meta-schemas/core.yaml#

title: TI eDMA3 Channel Controller

maintainers:
  - Johan Hovold <johan@kernel.org>
  - Lokesh Vutla <lokeshvutla@ti.com>
  - Marco Franchi <marco.franchi@nxp.com>
  - Matt Porter <mdp@ti.com>
  - Peter Ujfalusi <peter.ujfalusi@ti.com>
  - Robert P. J. Day <rpjday@crashcourse.ca>

description: |
  The eDMA3 consists of two components: Channel controller (CC) and Transfer
  Controller(s) (TC). The CC is the main entry for DMA users since it is
  responsible for the DMA channel handling, while the TCs are responsible to
  execute the actual DMA transfer.

  ------------------------------------------------------------------------------
  DEPRECATED binding, new DTS files must use the ti,edma3-tpcc/ti,edma3-tptc
  binding.

properties:
  compatible:
    oneOf:
      - items:
          - enum:
              - ti,edma3-tpcc
      - items:
          - enum:
              - ti,k2g-edma3-tpcc
              - ti,edma3-tpcc

  reg:
    maxItems: 1

  reg-names:
    items:
      - const: edma3_cc

  interrupts:
    items:
      - description: Channel controller interrupt (CCINT)
      - description: Memory protection interrupt (MPERR)
      - description: Error interrupt (CCERRINT)

  interrupt-names:
    items:
      - const: edma3_ccint
      - const: edma3_mperr
      - const: edma3_ccerrint

  '#dma-cells':
    const: 2

  dma-requests:
    description: Number of DMA request lines exposed by the CC

  ti,tptcs:
    description: List of transfer controllers (TC) and their priorities
    $ref: /schemas/types.yaml#/definitions/phandle
    items:
      maxItems: 2

  ti,edma-memcpy-channels:
    description: Channels reserved for software‐triggered memcpy
    $ref: /schemas/types.yaml#/definitions/uint32-array

  ti,edma-reserved-slot-ranges:
    description: PaRAM slot ranges reserved for other masters
    $ref: /schemas/types.yaml#/definitions/uint32-matrix
    items:
      items:
        - description: First slot number
        - description: Number of consecutive slots

  dma-channel-mask:
    description: Mask of channels usable by clients
    items:
      - description: Mask for channels 0–31
      - description: Mask for channels 32–63

required:
  - compatible
  - reg
  - interrupts
  - '#dma-cells'

additionalProperties: false

examples:
  - |
    edma: edma@49000000 {
        compatible = "ti,edma3-tpcc";
        ti,hwmods = "tpcc";
        reg = <0x49000000 0x10000>;
        reg-names = "edma3_cc";
        interrupts = <12 13 14>;
        interrupt-names = "edma3_ccint", "edma3_mperr", "edma3_ccerrint";
        #dma-cells = <2>;
        ti,tptcs = <&edma_tptc0 7>, <&edma_tptc1 7>, <&edma_tptc2 0>;
        ti,edma-memcpy-channels = <20 21>;
        ti,edma-reserved-slot-ranges = <35 10>, <100 10>;
        dma-channel-mask = <0xffffffff 0xffffe007>;
        dma-requests = <64>;
    };
```

## Documentation/devicetree/bindings/iommu/nvidia,tegra30-smmu.yaml
```yaml
# SPDX-License-Identifier: (GPL-2.0-only OR BSD-2-Clause)
%YAML 1.2
---
$id: http://devicetree.org/schemas/iommu/nvidia,tegra30-smmu.yaml#
$schema: http://devicetree.org/meta-schemas/core.yaml#

title: NVIDIA Tegra30 SMMU

maintainers:
  - Hiroshi Doyu <hdoyu@nvidia.com>

properties:
  compatible:
    items:
      - const: nvidia,tegra30-smmu

  reg:
    items:
      - description: bank 0 registers
      - description: bank 1 registers
      - description: bank 2 registers

  interrupts:
    items:
      - description: MC General interrupt

  nvidia,#asids:
    description: Number of ASIDs.
    $ref: /schemas/types.yaml#/definitions/uint32

  dma-window:
    $ref: /schemas/types.yaml#/definitions/address
    description: IOVA start address and length.

  nvidia,ahb:
    description: Phandle to the AHB bus connected to SMMU.
    $ref: /schemas/types.yaml#/definitions/phandle

required:
  - compatible
  - reg
  - interrupts
  - nvidia,#asids
  - dma-window
  - nvidia,ahb

additionalProperties: false

examples:
  - |
    smmu {
        compatible = "nvidia,tegra30-smmu";
        reg = <0x7000f010 0x02c
               0x7000f1f0 0x010
               0x7000f228 0x05c>;
        nvidia,#asids = <4>;
        dma-window = <0 0x40000000>;
        nvidia,ahb = <&ahb>;
    };
```

## Documentation/devicetree/bindings/leds/ti,lm36274.yaml
```yaml
# SPDX-License-Identifier: (GPL-2.0-only OR BSD-2-Clause)
%YAML 1.2
---
$id: http://devicetree.org/schemas/leds/ti,lm36274.yaml#
$schema: http://devicetree.org/meta-schemas/core.yaml#

title: Texas Instruments LM36274 4-Channel LCD Backlight Driver

maintainers:
  - Alexander A. Klimov <grandmaster@al2klimov.de>
  - Dan Murphy <dmurphy@ti.com>

description: |
  * Texas Instruments LM36274 4-Channel LCD Backlight Driver w/Integrated Bias

  The LM36274 is an integrated four-channel WLED driver and LCD bias supply.
  The backlight boost provides the power to bias four parallel LED strings with
  up to 29V total output voltage. The 11-bit LED current is programmable via
  the I2C bus and/or controlled via a logic level PWM input from 60 uA to 30 mA.

  Parent device properties are documented in
  Documentation/devicetree/bindings/mfd/ti-lmu.txt

  Regulator properties are documented in
  Documentation/devicetree/bindings/regulator/lm363x-regulator.txt

  For more product information please see the link below:
  https://www.ti.com/lit/ds/symlink/lm36274.pdf

properties:
  compatible:
    const: ti,lm36274-backlight

  '#address-cells':
    const: 1

  '#size-cells':
    const: 0

patternProperties:
  '^led@[0-3]$':
    description: LED string configuration.
    $ref: /schemas/leds/common.yaml#
    additionalProperties: false

    properties:
      reg:
        items:
          - description: LED identifier.

      led-sources:
        description: LED strings to enable, values 0-3.
        items:
          minimum: 0
          maximum: 3

    required:
      - reg
      - led-sources

required:
  - compatible
  - '#address-cells'
  - '#size-cells'

additionalProperties: false
```

## Documentation/devicetree/bindings/media/st,comms-irb.yaml
```yaml
# SPDX-License-Identifier: (GPL-2.0-only OR BSD-2-Clause)
%YAML 1.2
---
$id: http://devicetree.org/schemas/st,comms-irb.yaml#
$schema: http://devicetree.org/meta-schemas/core.yaml#

title: ST Comms IRB controller

maintainers:
  - Srinivas Kandagatla <srinivas.kandagatla@st.com>

description: |
  Device-Tree bindings for ST IRB IP

properties:
  compatible:
    const: st,comms-irb

  reg:
    maxItems: 1

  clocks:
    maxItems: 1

  interrupts:
    maxItems: 1

  rx-mode:
    description: >
      Specifies the L1 protocol used for receiving remote control signals;
      required if rx pins are wired up
    enum:
      - infrared
      - uhf

  tx-mode:
    description: >
      Specifies the L1 protocol used for transmitting remote control signals;
      required if tx pins are wired up
    enum:
      - infrared

required:
  - compatible
  - reg
  - interrupts

additionalProperties: false

examples:
  - |
    rc@fe518000 {
        compatible = "st,comms-irb";
        reg = <0xfe518000 0x234>;
        interrupts = <0 203 0>;
        rx-mode = "infrared";
    };
```
